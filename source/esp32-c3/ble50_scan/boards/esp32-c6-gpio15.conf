## source/esp32-c3/ble50_scan/boards/esp32-c6-gpio15.conf
```kconfig
#
# ESP32-C6 Super Mini board configuration
#
CONFIG_BOARD_SUPERMINI_C6=y
CONFIG_BOARD_LED_TYPE_RGB=y
CONFIG_BOARD_LED_GPIO=15
CONFIG_BOARD_LED_ACTIVE_LOW=n
CONFIG_BOARD_LED_IDLE_LEVEL=0
CONFIG_BOARD_LED_PULSE_US=25000
CONFIG_BOARD_HW_VERSION=0xC6
```

## source/esp32-c3/ble50_scan/boards/supermini-c3.conf
```kconfig
#
# ESP32-C3 Super Mini board configuration
#
CONFIG_BOARD_SUPERMINI_C3=y
CONFIG_BOARD_LED_GPIO=8
CONFIG_BOARD_LED_ACTIVE_LOW=y
CONFIG_BOARD_LED_IDLE_LEVEL=1
CONFIG_BOARD_LED_PULSE_US=25000
CONFIG_BOARD_HW_VERSION=0xC3
```

## source/esp32-c3/ble50_scan/sdkconfig.defaults
```kconfig
#
# BLE configuration defaults for ble50_scan
# Applied automatically by 'idf.py set-target'
#
CONFIG_BT_ENABLED=y
CONFIG_BT_BLUEDROID_ENABLED=y
CONFIG_BT_CONTROLLER_ENABLED=y
CONFIG_BT_BLE_ENABLED=y
CONFIG_BT_GATTS_ENABLE=y
CONFIG_BT_GATTC_ENABLE=y
CONFIG_BT_BLE_SMP_ENABLE=y
CONFIG_BT_BLE_50_FEATURES_SUPPORTED=y
CONFIG_BT_BLE_50_EXTEND_ADV_EN=y
CONFIG_BT_BLE_50_PERIODIC_ADV_EN=y
CONFIG_BT_BLE_50_EXTEND_SCAN_EN=y
CONFIG_BT_BLE_50_EXTEND_SYNC_EN=y
CONFIG_BT_BLE_50_DTM_TEST_EN=y
CONFIG_BT_CTRL_BLE_SCAN=y
CONFIG_BT_STACK_NO_LOG=y
```

## source/esp32ble/ble50_scan/boards/esp32-c6-gpio8.conf
```kconfig
#
# ESP32-C6 Mini — SK6812 RGB LED on GPIO8
#
CONFIG_BOARD_LED_TYPE_RGB=y
CONFIG_BOARD_LED_GPIO=8
CONFIG_BOARD_LED_ACTIVE_LOW=n
CONFIG_BOARD_LED_IDLE_LEVEL=0
CONFIG_BOARD_LED_PULSE_US=25000
CONFIG_BOARD_HW_VERSION=0xC6

# Supported GPIOs
CONFIG_BOARD_GPIO_0=y
CONFIG_BOARD_GPIO_1=y
CONFIG_BOARD_GPIO_2=y
CONFIG_BOARD_GPIO_3=y
CONFIG_BOARD_GPIO_4=y
CONFIG_BOARD_GPIO_5=y
CONFIG_BOARD_GPIO_6=y
CONFIG_BOARD_GPIO_7=y
CONFIG_BOARD_GPIO_8=y
CONFIG_BOARD_GPIO_9=y
CONFIG_BOARD_GPIO_10=y
CONFIG_BOARD_GPIO_12=y
CONFIG_BOARD_GPIO_13=y
CONFIG_BOARD_GPIO_14=y
CONFIG_BOARD_GPIO_15=y
CONFIG_BOARD_GPIO_18=y
CONFIG_BOARD_GPIO_19=y
CONFIG_BOARD_GPIO_20=y
CONFIG_BOARD_GPIO_21=y
CONFIG_BOARD_GPIO_22=y
CONFIG_BOARD_GPIO_23=y
```

## source/esp32ble/ble50_scan/main/Kconfig
```kconfig
menu "Board LED / RMT Configuration"

config LED_GPIO
    int "Regular LED GPIO number (0 = none)"
    default 0
    range 0 48
    help
        GPIO for a regular single-colour LED driven by PWM (LEDC).
        Set to 0 if no regular LED is present. Configured via --led <gpio>.

config LED_ACTIVE_LOW
    bool "Regular LED is active-low"
    depends on LED_GPIO != 0
    default y
    help
        Set if the regular LED is active-low (HIGH = OFF, LOW = ON).

config LED_IDLE_LEVEL
    int "Regular LED idle level"
    depends on LED_GPIO != 0
    default 1
    help
        Idle level for the regular LED. 1 = OFF (for active-low LED), 0 = ON.

config RGB_GPIO
    int "RGB LED (SK6812/WS2812) GPIO number (0 = none)"
    default 0
    range 0 48
    help
        GPIO for an SK6812/WS2812 addressable RGB LED driven via RMT.
        Set to 0 if no RGB LED is present. Configured via --rgb <gpio>.

config RGB_LED_ORDER_GRB
    bool "RGB LED uses GRB byte order (WS2812 standard)"
    depends on RGB_GPIO != 0
    default y
    help
        Most WS2812/SK6812 LEDs expect GRB byte order (Green, Red, Blue).
        Some boards (e.g. certain ESP32-S3 variants) use RGB order.
        Disable this if red and green appear swapped on your LED.

choice ADV_BLINK
    prompt "Advertisement blink target"
    default ADV_BLINK_LED if LED_GPIO != 0
    default ADV_BLINK_RGB if RGB_GPIO != 0
    default ADV_BLINK_NONE
    help
        Which LED blinks on received advertisements.
        Configured via --adv <led|rgb|none>.

config ADV_BLINK_LED
    bool "Regular LED"
    depends on LED_GPIO != 0

config ADV_BLINK_RGB
    bool "RGB LED"
    depends on RGB_GPIO != 0

config ADV_BLINK_NONE
    bool "None"
endchoice

config BOARD_LED_PULSE_US
    int "Activity pulse duration (μs)"
    default 25000
    range 1000 1000000
    help
        Duration of the activity pulse in microseconds.

config BOARD_HW_VERSION
    hex "Hardware version byte"
    default 0xC3
    range 0x00 0xFF
    help
        Hardware version reported in INFO responses.
        Auto-derived from the target chip name (e.g. 0xC3 for esp32c3).

endmenu

menu "Board Supported GPIOs"

config BOARD_GPIO_0
    bool "GPIO0"
    default y
config BOARD_GPIO_1
    bool "GPIO1"
    default y
config BOARD_GPIO_2
    bool "GPIO2"
    default y
config BOARD_GPIO_3
    bool "GPIO3"
    default y
config BOARD_GPIO_4
    bool "GPIO4"
    default y
config BOARD_GPIO_5
    bool "GPIO5"
    default y
config BOARD_GPIO_6
    bool "GPIO6"
    default y
config BOARD_GPIO_7
    bool "GPIO7"
    default y
config BOARD_GPIO_8
    bool "GPIO8"
    default y
config BOARD_GPIO_9
    bool "GPIO9"
    default y
config BOARD_GPIO_10
    bool "GPIO10"
    default y
config BOARD_GPIO_11
    bool "GPIO11"
    default n
config BOARD_GPIO_12
    bool "GPIO12"
    default y
config BOARD_GPIO_13
    bool "GPIO13"
    default y
config BOARD_GPIO_14
    bool "GPIO14"
    default y
config BOARD_GPIO_15
    bool "GPIO15"
    default y
config BOARD_GPIO_16
    bool "GPIO16 (USB D- on C3/S3)"
    default n
config BOARD_GPIO_17
    bool "GPIO17 (USB D+ on C3/S3)"
    default n
config BOARD_GPIO_18
    bool "GPIO18"
    default y
config BOARD_GPIO_19
    bool "GPIO19"
    default y
config BOARD_GPIO_20
    bool "GPIO20"
    default y
config BOARD_GPIO_21
    bool "GPIO21"
    default y
config BOARD_GPIO_22
    bool "GPIO22"
    default y
config BOARD_GPIO_23
    bool "GPIO23"
    default y
config BOARD_GPIO_24
    bool "GPIO24"
    default n
config BOARD_GPIO_25
    bool "GPIO25"
    default n
config BOARD_GPIO_26
    bool "GPIO26"
    default n
config BOARD_GPIO_27
    bool "GPIO27"
    default n
config BOARD_GPIO_28
    bool "GPIO28"
    default n
config BOARD_GPIO_29
    bool "GPIO29"
    default n
config BOARD_GPIO_30
    bool "GPIO30"
    default n
config BOARD_GPIO_31
    bool "GPIO31"
    default n
config BOARD_GPIO_32
    bool "GPIO32"
    default n
config BOARD_GPIO_33
    bool "GPIO33"
    default n
config BOARD_GPIO_34
    bool "GPIO34"
    default n
config BOARD_GPIO_35
    bool "GPIO35"
    default n
config BOARD_GPIO_36
    bool "GPIO36"
    default n
config BOARD_GPIO_37
    bool "GPIO37"
    default n
config BOARD_GPIO_38
    bool "GPIO38"
    default n
config BOARD_GPIO_39
    bool "GPIO39"
    default n
config BOARD_GPIO_40
    bool "GPIO40"
    default n
config BOARD_GPIO_41
    bool "GPIO41"
    default n
config BOARD_GPIO_42
    bool "GPIO42"
    default n
config BOARD_GPIO_43
    bool "GPIO43"
    default n
config BOARD_GPIO_44
    bool "GPIO44"
    default n
config BOARD_GPIO_45
    bool "GPIO45"
    default n
config BOARD_GPIO_46
    bool "GPIO46"
    default n
config BOARD_GPIO_47
    bool "GPIO47 (SPICLK_P on S3)"
    default n
config BOARD_GPIO_48
    bool "GPIO48 (SPICLK_N on S3)"
    default n

endmenu
```
